## config/west.yml
```yaml
manifest:
  defaults:
    revision: v0.3
  remotes:
    - name: zmkfirmware
      url-base: https://github.com/zmkfirmware
    - name: module_corne_myhw_base
      url-base: https://github.com/patrickgutbell/myzmkmodules.git
    # Additional modules containing boards/shields/custom code can be listed here as well
    # See https://docs.zephyrproject.org/3.2.0/develop/west/manifest.html#projects
  projects:
    - name: zmk
      remote: zmkfirmware
      import: app/west.yml
    - name: module_corne_myhw
      remote: module_corne_myhw_base
      revision: main
  self:
    path: config
```
